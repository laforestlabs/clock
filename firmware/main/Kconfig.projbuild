## firmware/main/Kconfig.projbuild
```kconfig
menu "Smart Mirror"

    menu "Network"

        config MIRROR_CONNECT_TIMEOUT_S
            int "Seconds to try saved credentials before opening the setup portal"
            default 30
            range 5 120
            help
                On boot with saved credentials the mirror tries to join the
                home network for this long. If it has no address by then it
                opens its own setup access point instead, where the owner can
                enter new details. Wrong-password and missing-network
                failures open the portal sooner, as soon as the reason is
                known.

        config MIRROR_AP_SSID
            string "Setup access point name"
            default "Smart Mirror Setup"
            help
                The network the mirror creates when it has no working
                credentials. The last four hex digits of the MAC are appended,
                so several mirrors in one house do not collide. The setup page
                is served at http://192.168.4.1.

        config MIRROR_AP_PASSWORD
            string "Setup access point password (empty = open)"
            default ""
            help
                Leave empty for an open setup network. For a deployed product
                set a WPA2 password here (8 to 63 characters) and print it on
                the device: on an open network, anyone within radio range can
                open the setup page and claim the mirror.

                Home WiFi credentials are never compiled in. The owner enters
                them through the setup portal and they are stored in the
                device's NVS.

        config MIRROR_WIFI_MAX_RETRY
            int "Reconnect attempts before backing off"
            default 8
            help
                After this many consecutive failures the firmware waits before
                trying again, rather than hammering the access point. The panel
                keeps rendering throughout; it just shows stale data.

        config MIRROR_SNTP_SERVER
            string "SNTP server"
            default "pool.ntp.org"

        config MIRROR_TIMEZONE
            string "POSIX timezone string"
            default "GMT0BST,M3.5.0/1,M10.5.0"
            help
                POSIX TZ format, which encodes daylight saving transitions so
                the clock does not need re-flashing twice a year.

                UK:          GMT0BST,M3.5.0/1,M10.5.0
                Central EU:  CET-1CEST,M3.5.0,M10.5.0/3
                US Eastern:  EST5EDT,M3.2.0,M11.1.0
                UTC:         UTC0

                Factory default only; the owner sets the live value from the
                phone app (Bluetooth) and it is stored in NVS.

    endmenu

    menu "Display"

        config MIRROR_CLOCK_12H
            bool "12-hour clock (24-hour when off)"
            default y
            help
                The default face for clock widgets that do not carry an
                explicit format: "3:41" on, "15:41" off. A layout that
                pins its own format always wins over this.

                Factory default only; the owner sets the live value from the
                phone app (Bluetooth) and it is stored in NVS.

        choice MIRROR_TEMP_UNIT
            prompt "Temperature unit"
            default MIRROR_TEMP_UNIT_F
            help
                How temperatures are displayed: the weather widget's
                temperature line and high/low row, and anything bound to the
                display-facing weather.temp paths in the layout.

                Factory default only; the owner sets the live value from the
                phone app (Bluetooth) and it is stored in NVS.

            config MIRROR_TEMP_UNIT_F
                bool "Fahrenheit"
            config MIRROR_TEMP_UNIT_C
                bool "Celsius"
        endchoice

    endmenu

    menu "Weather"

        config MIRROR_LATITUDE
            string "Latitude"
            default "51.5074"
            help
                Decimal degrees. Kconfig has no float type, so this is a
                string and gets substituted into the query as written.

                Open-Meteo needs no API key and no signup, which means the
                mirror has no weather credential to expire or leak.

                Factory default only; the owner sets the live value from the
                phone app (Bluetooth) and it is stored in NVS.

        config MIRROR_LONGITUDE
            string "Longitude"
            default "-0.1278"
            help
                Decimal degrees, negative for west.

                Factory default only; the owner sets the live value from the
                phone app (Bluetooth) and it is stored in NVS.

        config MIRROR_PLACE_NAME
            string "Place label"
            default "Home"
            help
                Shown by anything bound to weather.place. Purely cosmetic;
                the forecast comes from the coordinates above.

                Factory default only; the owner sets the live value from the
                phone app (Bluetooth) and it is stored in NVS.

        config MIRROR_WEATHER_INTERVAL_S
            int "Refresh interval (seconds)"
            default 900
            range 300 21600
            help
                Every 15 minutes is 96 calls a day, comfortably inside
                Open-Meteo's free allowance, and the data itself only updates
                about every 15 minutes anyway. Polling faster gains nothing.

                Data is marked stale after three missed intervals, at which
                point widgets show a placeholder rather than a stale reading.

    endmenu

    menu "Panel"

        config MIRROR_PANEL_WIDTH
            int "Single panel width in pixels"
            default 64

        config MIRROR_PANEL_HEIGHT
            int "Single panel height in pixels"
            default 32
            help
                32 for the stock P2.5-64x32 panel. A 64-row panel is 1/32 scan
                and also needs the E address line wired, see MIRROR_PIN_E.

        config MIRROR_PANEL_COLS
            int "Panels across"
            default 1
            help
                One P2.5-64x32 gives the 64x32 canvas the default layout is
                tuned for. Two 64x64 panels side by side instead gives 128x64,
                which is what layouts/dual.json expects.

        config MIRROR_PANEL_ROWS
            int "Panels down"
            default 1

        choice MIRROR_SHIFT_DRIVER
            prompt "Shift register driver IC"
            default MIRROR_SHIFT_GENERIC
            help
                Waveshare ships these panels with either an ICN2038S, which
                needs no setup, or an FM6126A, which needs an initialisation
                sequence and stays completely dark without it. Which one is in
                the box is not documented per unit.

                If the panel is dark or shows garbage on first power-up, try
                the other option here before suspecting your wiring.

            config MIRROR_SHIFT_GENERIC
                bool "Generic (works for ICN2038S and most panels)"
            config MIRROR_SHIFT_FM6126A
                bool "FM6126A"
            config MIRROR_SHIFT_ICN2038S
                bool "ICN2038S"
            config MIRROR_SHIFT_FM6124
                bool "FM6124"
            config MIRROR_SHIFT_MBI5124
                bool "MBI5124"
            config MIRROR_SHIFT_DP3246
                bool "DP3246"
        endchoice

        config MIRROR_BRIGHTNESS
            int "Panel brightness (0-255)"
            range 0 255
            default 120
            help
                Applied by the driver in hardware, by shortening LED on-time.
                Doing it there rather than by scaling colour values preserves
                the full colour depth, which matters at the low settings a
                mirror behind glass actually runs at.

                Start low. These panels are rated 4A each at full white.

        config MIRROR_BRIGHTNESS_DEFAULT
            int "Config brightness default (-1 = follow the layout)"
            range -1 255
            default -1
            help
                Seeded into NVS as the owner config's brightness key on first
                boot. -1 means the pushed layout's brightness wins; 0..255 is
                a manual override the phone sets over Bluetooth. This is
                separate from MIRROR_BRIGHTNESS, which is only the panel's
                power-on brightness before any layout or override is applied.

        config MIRROR_MIN_REFRESH_HZ
            int "Minimum refresh rate (Hz)"
            default 60
            help
                The driver trades colour depth against refresh rate to meet
                this. Below about 60Hz the panel visibly flickers, especially
                in peripheral vision, which is exactly how a mirror is seen.

        config MIRROR_TEST_PATTERN
            bool "Show a colour test pattern at boot"
            default y
            help
                Draws red, green, blue and white bars for two seconds before
                normal rendering. Worth keeping during bring-up: it makes a
                swapped colour channel or a dead data line obvious
                immediately, rather than looking like a layout problem.

        config MIRROR_SWAP_GB
            bool "Swap green and blue channels"
            default n
            help
                Set when the boot test pattern reads red, blue, green instead
                of red, green, blue, meaning the panel's green and blue data
                lines are crossed at the connector or inside the panel. The
                swap happens in panel_blit_rgb888, after gamma and before the
                shift registers, so the render core and the desktop preview
                keep producing the true colours.

    endmenu

    menu "Panel pins (ESP32-S3 N16R8)"

        comment "Avoid GPIO 0/3/45/46 (strapping), 26-32 (flash), 33-37 (octal PSRAM)"

        config MIRROR_PIN_R1
            int "R1"
            default 4
        config MIRROR_PIN_G1
            int "G1"
            default 5
        config MIRROR_PIN_B1
            int "B1"
            default 6
        config MIRROR_PIN_R2
            int "R2"
            default 7
        config MIRROR_PIN_G2
            int "G2"
            default 15
        config MIRROR_PIN_B2
            int "B2"
            default 16
        config MIRROR_PIN_A
            int "A"
            default 17
        config MIRROR_PIN_B
            int "B"
            default 18
        config MIRROR_PIN_C
            int "C"
            default 8
        config MIRROR_PIN_D
            int "D"
            default 9
        config MIRROR_PIN_E
            int "E"
            default -1
            help
                The fifth address line. Only 64-row panels need it, because
                only they are 1/32 scan. The stock P2.5-64x32 is 1/16 scan and
                leaves this unwired, which is why it defaults to -1 and GPIO10
                stays free.

                Set it to 10 when moving to 64-row panels, matching the rest of
                the stock pin map. Some older HUB75 diagrams show ground in this
                position; that is correct for 1/16 scan panels and wrong for a
                64-row one, which stays dark or shows doubled rows without it.
        config MIRROR_PIN_LAT
            int "LAT"
            default 11
        config MIRROR_PIN_OE
            int "OE"
            default 12
        config MIRROR_PIN_CLK
            int "CLK"
            default 13

    endmenu

endmenu
```
